//YANA 10 JAAR

#include <FastLED.h>
#include <Arduino.h>

#define LED_PIN 8
#define WIDTH 16
#define HEIGHT 32
#define NUM_LEDS (WIDTH * HEIGHT)
#define BRIGHTNESS 80

CRGB leds[NUM_LEDS];

// Simpele 5x7 font (hoofdletters + cijfers, spaties)
const uint8_t font[][5] = {
  // A-Z, 0-9, spatie
  {0x7C, 0x12, 0x12, 0x7C, 0x00}, // A
  {0x7E, 0x4A, 0x4A, 0x34, 0x00}, // B
  {0x3C, 0x42, 0x42, 0x24, 0x00}, // C
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  {0x00, 0x00, 0x00, 0x00, 0x00}  // space
};

int8_t charIndex(char c) {
  if (c >= 'A' && c <= 'Z') return c - 'A';
  if (c >= '0' && c <= '9') return 26 + (c - '0');
  if (c == ' ') return 36;
  return 36; // space als fallback
}

const char* message = " YANA 10 JAAR   ";
int scroll = WIDTH;
unsigned long lastTime = 0;

uint16_t XY(uint8_t x, uint8_t y) {
  if (x < 8) {
    // Linker matrix: normale zigzag
    if (y % 2 == 0) {
      return y * 8 + x;
    } else {
      return y * 8 + (7 - x);
    }
  } else {
    // Rechter matrix: 180 graden gedraaid
    uint8_t rx = x - 8;
    uint8_t ry = 31 - y;  // Y-coordinaat omdraaien voor 180° rotatie
    
    if (ry % 2 == 0) {
      return 256 + ry * 8 + (7 - rx);  // X-coordinaat ook omdraaien
    } else {
      return 256 + ry * 8 + rx;
    }
  }
}

void drawChar(char c, int x_offset, CRGB color) {
  int8_t idx = charIndex(toupper(c));
  for (uint8_t col = 0; col < 5; col++) {
    uint8_t bits = font[idx][col];
    for (uint8_t row = 0; row < 7; row++) {
      if (bits & (1 << (6 - row))) {
        int x = x_offset + col;
        int y = row + 12;
        if (x >= 0 && x < WIDTH && y >= 0 && y < HEIGHT) {
          leds[XY(x, y)] = color;
        }
      }
    }
  }
}

void setup() {
  FastLED.addLeds<WS2812B, LED_PIN, GRB>(leds, NUM_LEDS);
  FastLED.setBrightness(BRIGHTNESS);
  fill_solid(leds, NUM_LEDS, CRGB::Black);
  FastLED.show();
}

void loop() {
  if (millis() - lastTime > 80) {
    fill_solid(leds, NUM_LEDS, CRGB::Black);
    int x = scroll;
    for (uint8_t i = 0; i < strlen(message); i++) {
      CRGB color = CHSV(40 + i * 30, 255, 200);
      drawChar(message[i], x, color);
      x += 6;
    }
    scroll--;
    if (scroll < -((int)strlen(message) * 6)) scroll = WIDTH;
    FastLED.show();
    lastTime = millis();
  }
}
